/ {
    chosen {
        zmk,kscan = &kscan0;
        zmk,keymap = &keymap;  /* この一行を追加 */
    };

    /* ...以下の kscan0 定義などはそのまま... */
};

/* ファイルの最後（ }; の外側）にこれを追記 */
&keymap {
    compatible = "zmk,keymap";
};
